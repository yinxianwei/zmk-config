## config/Kconfig.defconfig
```kconfig
# Copyright (c) 2021 The ZMK Contributors
# SPDX-License-Identifier: MIT

if SHIELD_KB_4

config ZMK_KEYBOARD_NAME
	default "KB_4"

endif
```

## config/Kconfig.shield
```kconfig
# Copyright (c) 2020 The ZMK Contributors
# SPDX-License-Identifier: MIT

config SHIELD_KB_4
    def_bool $(shields_list_contains,kb_4)
```
